/* Copyright (c) 2015, The Linux Foundation. All rights reserved.
 * Copyright (C) 2019 XiaoMi, Inc.
 *
 * This program is free software; you can redistribute it and/or modify
 * it under the terms of the GNU General Public License version 2 and
 * only version 2 as published by the Free Software Foundation.
 *
 * This program is distributed in the hope that it will be useful,
 * but WITHOUT ANY WARRANTY; without even the implied warranty of
 * MERCHANTABILITY or FITNESS FOR A PARTICULAR PURPOSE.  See the
 * GNU General Public License for more details.
 */

/*---------------------------------------------------------------------------
 * This file is autogenerated file using gcdb parser. Please do not edit it.
 * Update input XML file to add a new entry or update variable in this file
 * VERSION = "1.0"
 *---------------------------------------------------------------------------*/
&soc {
	dsi_jdi_fhd_r63452_cmd: qcom,mdss_dsi_jdi_fhd_r63452_cmd {
		qcom,mdss-dsi-panel-name = "jdi fhd cmd incell dsi panel";
		qcom,mdss-dsi-panel-id = <0>;
		qcom,mdss-dsi-panel-model = "JDI FHD R63452 CMD PANEL";
		qcom,mdss-dsi-panel-sleepwrmod = <0>;
		qcom,mdss-dsi-panel-type = "dsi_cmd_mode";
		qcom,mdss-dsi-panel-framerate = <60>;
		qcom,mdss-dsi-virtual-channel-id = <0>;
		qcom,mdss-dsi-stream = <0>;
		qcom,mdss-dsi-panel-width = <1080>;
		qcom,mdss-dsi-panel-height = <1920>;
		qcom,mdss-dsi-h-front-porch = <120>;
		qcom,mdss-dsi-h-back-porch = <76>;
		qcom,mdss-dsi-h-pulse-width = <16>;
		qcom,mdss-dsi-h-sync-skew = <0>;
		qcom,mdss-dsi-v-back-porch = <6>;
		qcom,mdss-dsi-v-front-porch = <8>;
		qcom,mdss-dsi-v-pulse-width = <2>;
		qcom,mdss-dsi-h-left-border = <0>;
		qcom,mdss-dsi-h-right-border = <0>;
		qcom,mdss-dsi-v-top-border = <0>;
		qcom,mdss-dsi-v-bottom-border = <0>;
		qcom,mdss-dsi-bpp = <24>;
		qcom,mdss-dsi-color-order = <0>;
		qcom,mdss-dsi-underflow-color = <0xff>;
		qcom,mdss-dsi-border-color = <0>;
        /* DSI ON Command Sequence from manufacturer file */
        qcom,mdss-dsi-on-command = [
            29 04 B9 83 10 2E FF 05
            15 02 E9 CD FF 05
            15 02 BB 01 FF 05
            15 02 E9 00 FF 05
            29 05 D1 67 0C FF 05 FF 05
            29 12 B1 10 FA AF AF 29 29 B1 6B 31 36 36 36 36 22 21 15 00 FF 05
            29 11 B2 00 B0 47 80 00 26 E0 29 13 00 00 00 15 20 D7 00 FF 05
            29 11 B4 6A 70 6A 70 6A 90 6A 90 01 9F 01 58 00 FF 00 FF FF 05
            15 03 D2 29 29 FF 05
            15 04 B6 5A 5A E3 FF 05
            29 08 BF FC 85 80 9C 36 00 04 FF 05
            29 2C D3 00 00 00 00 3C E8 00 00 00 37 37 33 0F 26 26 04 00 32 10 24 00 24 32 17 A8 07 A8 32 10 08 00 00 00 00 2B 50 B6 C8 2C 4F B6 C8 0F FF 05
            15 02 BD 01 FF 05
            29 0B CB 80 36 12 16 C0 28 54 84 02 34 FF 05
            29 0C D3 01 00 FC 00 00 11 10 00 0A 00 01 FF 05
            15 02 BD 02 FF 05
            29 07 B4 4E 00 33 11 33 88 FF 05
            15 04 BF F2 00 02 FF 05
            15 02 BD 00 FF 05
            29 0F C0 33 33 22 11 A2 17 00 80 00 00 08 00 63 63 FF 05
            29 2D D5 18 18 18 18 18 18 18 18 18 18 19 19 18 18 1A 1A 1B 1B 00 01 02 03 04 05 06 07 20 21 24 25 18 18 18 18 18 18 18 18 18 18 18 18 18 18 FF 05
            29 2D D6 18 18 18 18 18 18 18 18 18 18 18 18 19 19 1A 1A 1B 1B 07 06 05 04 03 02 01 00 25 24 21 20 18 18 18 18 18 18 18 18 18 18 18 18 18 18 FF 05
            29 31 E0 00 08 15 1E 27 49 63 6F 73 6F 88 8C 90 9D 99 A0 A7 B8 B5 58 60 69 73 00 08 15 1E 27 49 63 6F 73 6F 88 8C 90 9D 99 A0 A7 B8 B5 58 60 69 73 FF 05
            15 04 D0 07 04 05 FF 05
            29 18 E7 12 13 02 02 55 00 0E 0E 00 26 29 72 1C 72 01 27 00 00 00 00 17 00 68 FF 05
            15 02 BD 01 FF 05
            29 08 E7 01 30 01 94 0D B5 0E FF 05
            15 02 BD 02 FF 05
            29 1D E7 FF 01 FD 01 00 00 22 00 00 00 00 00 00 00 00 00 00 00 00 00 00 00 00 81 00 02 40 FF 05
            15 02 BD 00 FF 05
            29 0D D8 AA AB EA AA AA A0 AA AB EA AA AA A0 FF 05
            15 02 BD 01 FF 05
            29 0D D8 00 00 00 00 00 00 00 00 00 00 00 00 FF 05
            15 02 BD 02 FF 05
            29 0D D8 FF FF BF FF FF F0 FF FF BF FF FF F0 FF 05
            15 02 BD 03 FF 05
            29 1B D8 55 55 55 55 55 50 55 55 55 55 55 50 55 55 55 55 55 50 55 55 55 55 55 50 FF 05
            15 02 BD 00 FF 05
            15 02 CC 02 FF 05
            29 09 BA 70 03 A8 83 F2 80 C0 0D FF 05
            15 02 BD 00 FF 05
            29 09 C8 00 04 04 00 00 02 13 FF FF 05
            15 02 BD 00 FF 05
            29 06 CB 00 13 08 02 25 FF 05
            15 02 BD 02 FF 05
            29 06 CB 00 03 00 01 7E FF 05
            15 02 BD 00 FF 05
            29 08 C7 30 B0 C2 08 10 42 04 FF 05
            15 04 D1 67 0C 0F FF 05
            15 03 E1 00 01 FF 05
            15 04 B9 00 00 00 FF 05
            05 01 11 FF 78  /* Sleep Out, delay 120ms */
            05 01 29 FF 14   /* Display On, delay 20ms */
        ];

        qcom,mdss-dsi-off-command = [
            05 01 28 FF 14   /* Display Off, delay 20ms */
            05 01 10 FF 78   /* Sleep In, delay 120ms */
        ];
	
		/* qcom,mdss-dsi-displayoff-command = [39 01 00 00 20 00 02 28 00]; */
		/* qcom,mdss-dsi-displayon-command = [39 01 00 00 20 00 02 29 00]; */
		qcom,mdss-dsi-on-command-state = "dsi_lp_mode";
		qcom,mdss-dsi-off-command-state = "dsi_hs_mode";
		qcom,mdss-dsi-displayoff-command-state = "dsi_hs_mode";
		qcom,mdss-dsi-displayon-command-state = "dsi_hs_mode";
		qcom,mdss-dsi-h-sync-pulse = <0>;
		qcom,mdss-dsi-traffic-mode = "burst_mode";
		qcom,mdss-dsi-bllp-eof-power-mode;
		qcom,mdss-dsi-bllp-power-mode;
		qcom,mdss-dsi-lp11-init;
		qcom,mdss-dsi-lane-0-state;
		qcom,mdss-dsi-lane-1-state;
		qcom,mdss-dsi-lane-2-state;
		qcom,mdss-dsi-lane-3-state;
		qcom,mdss-dsi-panel-timings = [e3 50 36 00 a9 a3 3a 50 3d 03 04 00];
		qcom,mdss-dsi-t-clk-post = <0x20>;
		qcom,mdss-dsi-t-clk-pre = <0x36>;
		qcom,mdss-dsi-bl-min-level = <1>;
		qcom,mdss-dsi-bl-max-level = <4095>;
		qcom,mdss-brightness-max-level = <4095>;
		qcom,mdss-dsi-dma-trigger = "trigger_sw";
		qcom,mdss-dsi-mdp-trigger = "none";
		qcom,mdss-dsi-bl-pmic-control-type = "bl_ctrl_wled";
		qcom,mdss-dsi-reset-sequence = <1 10>, <0 1>, <1 10>;
		qcom,mdss-pan-physical-width-dimension = <68>;
		qcom,mdss-pan-physical-height-dimension = <121>;
		qcom,mdss-dsi-te-pin-select = <1>;
		qcom,mdss-dsi-wr-mem-start = <0x2c>;
		qcom,mdss-dsi-wr-mem-continue = <0x3c>;
		qcom,mdss-dsi-te-dcs-command = <1>;
		qcom,mdss-dsi-te-check-enable;
		qcom,mdss-dsi-te-using-te-pin;
		qcom,mdss-dsi-tx-eot-append;
		qcom,esd-err-irq-gpio = <&tlmm 74 0x2001>;
		qcom,mdss-panel-on-dimming-delay = <120>;
		qcom,mdss-dsi-dispparam-dimmingon-command = [
			39 01 00 00 01 00 02 53 2C
			];

		cm,mdss-livedisplay-command-state = "dsi_lp_mode";
		cm,mdss-livedisplay-cabc-ui-cmd = [
			29 01 00 00 00 00 02 B0 04
			15 01 00 00 00 00 02 55 81
			29 01 00 00 00 00 08 B8 89 51 0D 00 02 00 00
			29 01 00 00 00 00 1A CE 55 40 4C 5A 69 77 84 93 A2 B1 C1 D1 E0 F0 F1 F2 FF 04 00 04 04 42 00 69 5A
			29 01 00 00 00 00 0A F9 66 3F E0 BE 00 8D BF 80 00
			29 01 00 00 00 00 02 B0 03
		];
		cm,mdss-livedisplay-cabc-image-cmd = [
			29 01 00 00 00 00 02 B0 04
			15 01 00 00 00 00 02 55 82
			29 01 00 00 00 00 08 B9 FF 27 37 00 04 00 00
			29 01 00 00 00 00 1A CE 55 40 4C 5A 69 77 84 93 A2 B1 C1 D1 E0 F0 F1 F2 FF 04 00 04 04 42 00 69 5A
			29 01 00 00 00 00 0A F9 66 3F E0 BE 00 8D BF 80 00
			29 01 00 00 00 00 02 B0 03
		];
		cm,mdss-livedisplay-cabc-video-cmd = [
			29 01 00 00 00 00 02 B0 04
			15 01 00 00 00 00 02 55 83
			29 01 00 00 00 00 08 BA BB 3D 22 00 03 00 00
			29 01 00 00 00 00 1A CE 55 40 4C 5A 69 77 84 93 A2 B1 C1 D1 E0 F0 F1 F2 FF 04 00 04 04 42 00 69 5A
			29 01 00 00 00 00 0A F9 66 3F E0 BE 00 8D BF 80 00
			29 01 00 00 00 00 02 B0 03
		];
		cm,mdss-livedisplay-cabc-cmd = [
			39 01 00 00 01 00 02 55 00
		];
	};
};
