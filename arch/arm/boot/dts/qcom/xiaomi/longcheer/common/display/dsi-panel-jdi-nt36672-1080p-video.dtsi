/* Copyright (c) 2017, The Linux Foundation. All rights reserved.
 * Copyright (C) 2019 XiaoMi, Inc.
 *
 * This program is free software; you can redistribute it and/or modify
 * it under the terms of the GNU General Public License version 2 and
 * only version 2 as published by the Free Software Foundation.
 *
 * This program is distributed in the hope that it will be useful,
 * but WITHOUT ANY WARRANTY; without even the implied warranty of
 * MERCHANTABILITY or FITNESS FOR A PARTICULAR PURPOSE.  See the
 * GNU General Public License for more details.
 */

&mdss_mdp {
	dsi_nt36672_jdi_fhd_video: qcom,mdss_dsi_nt36672_jdi_fhd_video {
		qcom,mdss-dsi-panel-name = "jdi nt36672 fhd video mode dsi panel";
		qcom,mdss-dsi-panel-controller = <&mdss_dsi0>;
		qcom,mdss-dsi-panel-type = "dsi_video_mode";
		qcom,mdss-dsi-panel-framerate = <60>;
		qcom,mdss-dsi-virtual-channel-id = <0>;
		qcom,mdss-dsi-stream = <0>;
		qcom,mdss-dsi-panel-width = <1200>;
		qcom,mdss-dsi-panel-height = <1920>;
		qcom,mdss-pan-physical-width-dimension = <147>;
		qcom,mdss-pan-physical-height-dimension = <235>;
		qcom,mdss-dsi-h-front-porch = <40>;
		qcom,mdss-dsi-h-back-porch = <16>;
		qcom,mdss-dsi-h-pulse-width = <4>;
		qcom,mdss-dsi-h-sync-skew = <0>;
		qcom,mdss-dsi-v-back-porch = <32>;
		qcom,mdss-dsi-v-front-porch = <220>;
		qcom,mdss-dsi-v-pulse-width = <4>;
		qcom,mdss-dsi-h-left-border = <0>;
		qcom,mdss-dsi-h-right-border = <0>;
		qcom,mdss-dsi-v-top-border = <0>;
		qcom,mdss-dsi-v-bottom-border = <0>;
		qcom,mdss-dsi-bpp = <24>;
		qcom,mdss-dsi-underflow-color = <0xff>;
		qcom,mdss-dsi-border-color = <0>;
		qcom,mdss-dsi-h-sync-pulse = <0>;
		qcom,mdss-dsi-traffic-mode = "burst_mode";
		qcom,mdss-dsi-bllp-eof-power-mode;
		qcom,mdss-dsi-bllp-power-mode;
		qcom,mdss-dsi-lane-0-state;
		qcom,mdss-dsi-lane-1-state;
		qcom,mdss-dsi-lane-2-state;
		qcom,mdss-dsi-lane-3-state;
		qcom,mdss-dsi-panel-timings = [e6 38 26 00 68 6e 2a
				3c 44 03 04 00];
		qcom,mdss-dsi-t-clk-post = <0x0d>;
		qcom,mdss-dsi-t-clk-pre = <0x32>;
		qcom,mdss-dsi-bl-min-level = <1>;
		qcom,mdss-dsi-bl-max-level = <4095>;
		qcom,mdss-brightness-max-level = <4095>;
		qcom,mdss-dsi-dma-trigger = "trigger_sw";
		qcom,mdss-dsi-mdp-trigger = "none";

		qcom,mdss-dsi-on-command = [
			DF 93 86 19
			DE 00
			B2 01 23 60 55 88 DB
			B6 08 00 00 00 30 00
			BB 00 42 00 83 46 33 33 33 00 5A
			BD 00 4B//VCOM
			BF 53 E7 30 00 63 03 8D 00
			C0 11 22 01 22 01
			C3 03 01 42 07 00 00 00 00 01 01 01 01 01 01 02 08 01 01 01 08 A0 71 71 71 71 01 A0 71 71 71 01 A0 71 00 01 06 01 06 01 06 08 0E 0A 10 0A 10 04 57
			C4 01 02 00 00 10 01 01 01 02 08 01 01 01 08 A0 71 01 A0 01 A0 01 06 01 06 01 06 08 0E 01 06 01 06 04 57
			C6 01 58 00 DC 00 28 16 82 01 00 00 01 00 01 00 00 00 00 00 10 00 00 01
			C8 3B 80
			C9 0B 00
			CE 00 00 00 00 00 00 00 00 00 00 00 00 00 00 00 00 00 00 00 00 00 00 00 00 00 00 00 00 00 00 00 00 00 00 00 00 00 00 00 00 00 00 00 00 00 05 05 05 05 05 05 05 05 05 05 05 05 05 05 05 05 05 05 05 05 05 05
			CF 00 30 30 30 30 30 30 30 30 30 30 30 30 30 30 30 30 30 30 30 30 30 30 00 00 00 00 00 00 00 00 00 00 00 00 00 00 00 00 00 00 00 00 00 00
			D0 00 96 94 AA AB AB 9E 9F 2B 84 86 88 8A 8C 8E 90 92 82 80 2B 2B 2B 2B
			D1 00 97 95 AA AB AB 9E 9F 2B 85 87 89 8B 8D 8F 91 93 83 81 2B 2B 2B 2B
			D2 00 01 03 2B 2A 2B 1E 1F 2B 13 11 0F 0D 0B 09 07 05 15 17 2B 2B 2B 2B
			D3 00 00 02 2B 2A 2B 1E 1F 2B 12 10 0E 0C 0A 08 06 04 14 16 2B 2B 2B 2B
			D4 30 00 00 00 18 1C 00 00 00 00 99 00 D0 00 77 AE B0 00 01 04 04 04
			D5 03 00 30 00 00 00 01 00 00 00 E0 00 00 00 07 32 5A 10 0E 01 00 03 00 01 F6 00 1C 10 00 00 00 00 71 00 04 10 00 00 00 00 00 00 00 05 08 02 02 00 1B 00 00 00 00 00 00 00 00 00 00 00 00 00 00 00 00 00 00 00
			D7 00 98 80 80 80 80 80 80 80 80 80 80 80 A0 80 A0 80
			DE 01
			C8 04 01 04
			B9 01
			C2 00 00 05 55 55 6A AA BF FF F0 20 20 28 41 73 9A BB D7 EF 04 18 39 55 6D 83 96 A8 B9 C8 E7 05 24 46 6C 97 AE C9 E7 0A 33 65 84 A7 BC D3 EE FC
			C3 00 00 05 55 55 6A AA BF FF F0 20 20 28 41 73 9A BB D7 EF 04 18 39 55 6D 83 96 A8 B9 C8 E7 05 24 46 6C 97 AE C9 E7 0A 33 65 84 A7 BC D3 EE FC
			C4 00 00 05 55 55 6A AA BF FF F0 20 20 28 41 73 9A BB D7 EF 04 18 39 55 6D 83 96 A8 B9 C8 E7 05 24 46 6C 97 AE C9 E7 0A 33 65 84 A7 BC D3 EE FC
			C5 00 00 05 55 55 6A AA BF FF F0 20 20 28 41 73 9A BB D7 EF 04 18 39 55 6D 83 96 A8 B9 C8 E7 05 24 46 6C 97 AE C9 E7 0A 33 65 84 A7 BC D3 EE FC
			C6 00 00 05 55 55 6A AA BF FF F0 20 20 28 41 73 9A BB D7 EF 04 18 39 55 6D 83 96 A8 B9 C8 E7 05 24 46 6C 97 AE C9 E7 0A 33 65 84 A7 BC D3 EE FC
			C7 00 00 05 55 55 6A AA BF FF F0 20 20 28 41 73 9A BB D7 EF 04 18 39 55 6D 83 96 A8 B9 C8 E7 05 24 46 6C 97 AE C9 E7 0A 33 65 84 A7 BC D3 EE FC
			C9 05 7F 00 55 55 55 99 99 99 00 00 40 00
			DE 02
			C2 02 42 D0 02 00 C4 61 73 FB
			C4 02 11 07 00 1A
			C5 07 FF FF 07 FF FF
			C6 40 06
			D6 03 40 01 01 0D 40 10 64 70
			E6 10 0A C8
			EE 10 01 10 00
			DE 03
			D1 05 10
			DE 04
			CD 20 04 21 10 33
			CE 00 28 50 0A 5A 00 00
			DE 07
			DE 00
			B3 01 00 00 88
			11
			FF 78
			29
			FF 0A
			35 00];
		qcom,mdss-dsi-off-command = [
			05 01 00 00 14 00 02 28 00
			05 01 00 00 78 00 02 10 00
		];
		qcom,mdss-dsi-on-command-state = "dsi_lp_mode";
		qcom,mdss-dsi-off-command-state = "dsi_hs_mode";
		qcom,mdss-dsi-bl-pmic-control-type = "bl_ctrl_wled";
		qcom,mdss-dsi-reset-sequence = <1 1>, <0 6>, <1 10>;
		qcom,mdss-dsi-tx-eot-append;
		qcom,mdss-dsi-post-init-delay = <1>;

		qcom,esd-check-enabled;
		qcom,mdss-dsi-panel-status-command = [06 01 00 01 05 00 01 0A];
		qcom,mdss-dsi-panel-status-command-state = "dsi_hs_mode";
		qcom,mdss-dsi-panel-status-check-mode = "reg_read";
		qcom,mdss-dsi-panel-status-read-length = <1>;
		qcom,mdss-dsi-panel-status-value = <0x9c>;
		qcom,mdss-dsi-panel-max-error-count = <3>;

		cm,mdss-livedisplay-cabc-ui-cmd = [
			15 01 00 00 00 00 02 FF 23
			15 00 00 00 00 00 02 07 20
			15 00 00 00 00 00 02 08 05
			15 00 00 00 00 00 02 09 00
			15 00 00 00 00 00 02 10 95
			15 00 00 00 00 00 02 30 FF
			15 00 00 00 00 00 02 31 FF
			15 00 00 00 00 00 02 32 FF
			15 00 00 00 00 00 02 33 FF
			15 00 00 00 00 00 02 34 FF
			15 01 00 00 00 00 02 35 FF
			15 00 00 00 00 00 02 36 FF
			15 00 00 00 00 00 02 37 FF
			15 00 00 00 00 00 02 38 FF
			15 00 00 00 00 00 02 39 FF
			15 00 00 00 00 00 02 3A FF
			15 00 00 00 00 00 02 3B F9
			15 00 00 00 00 00 02 3D D9
			15 00 00 00 00 00 02 3F B9
			15 00 00 00 00 00 02 40 AB
			15 00 00 00 00 00 02 41 98
			15 01 00 00 00 00 02 FF 10
			15 01 00 00 00 00 02 55 01
		];
		cm,mdss-livedisplay-cabc-cmd = [
			15 01 00 00 00 00 02 FF 10
			15 01 00 00 00 00 02 55 00
		];
	};
};
